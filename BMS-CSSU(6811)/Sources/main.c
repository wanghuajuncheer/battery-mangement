/*=======================================================================
 *Subsystem:   裸机
 *File:        main.C
 *Author:      ZWB
 *Description: 通信：
               接口：
               波特率：
 ========================================================================
 * History:    修改历史记录列表
 * 1. Date:    
      Author:  
      Modification:  
                
========================================================================*/
#include  "Includes.h"

/*=======================================================================
 *函数名:      main（void）
 *功能:        主函数
 *参数:        无       
 *返回：       无
 *说明：       检测快充AD口，执行所有任务，是否从头开始执行任务。
========================================================================*/
void main(void) 
{  
    
    System_init();
    
    for(;;) 
    {
      Task_Handle();
    }
}
/*=======================================================================
 *函数名:      isrPIT0()
 *功能:        PIT中断函数
 *参数:        无       
 *返回：       无
 *说明：       时间计时函数与任务时间标志置1函数
========================================================================*/
#pragma CODE_SEG __NEAR_SEG NON_BANKED

interrupt void isrPIT0()               
{
   if(PITTF_PTF0 ==1) 
   {    
      PITTF_PTF0 = 1;
   }
   
   Task_Flag_Counter.Time_Flag600ms++;                                                                    
                                      
   Task_Roll();                                           
}                                                                                    

/*=======================================================================
 *函数名:      CAN()
 *功能:        CAN2中断接受函数
 *参数:        无       
 *返回：       无
 *说明：       时间计时函数与任务时间标志置1函数
========================================================================*/
interrupt void isrRcvCAN2()
{
    uint8 gRcvState2;
    CANFRAME mgGet2;
    if(!MSCAN2GetMsg(&mgGet2))
    {
        gRcvState2 = 1;
    }
    
}
  
#pragma CODE_SEG DEFAULT  